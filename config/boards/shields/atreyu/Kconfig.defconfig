## config/boards/shields/atreyu/Kconfig.defconfig
```kconfig
# Copyright (c) 2020 The ZMK Contributors
# SPDX-License-Identifier: MIT

if SHIELD_ATREYU

config ZMK_KEYBOARD_NAME
    default "Atreyu"

endif
```

## config/boards/shields/atreyu/Kconfig.shield
```kconfig
# Copyright (c) 2020 The ZMK Contributors
# SPDX-License-Identifier: MIT

config SHIELD_ATREYU
    def_bool $(shields_list_contains,atreyu)
```

## config/boards/shields/atreyu_rev2/Kconfig.defconfig
```kconfig
# Copyright (c) 2020 The ZMK Contributors
# SPDX-License-Identifier: MIT

if SHIELD_ATREYU_REV2

config ZMK_KEYBOARD_NAME
    default "Atreyu"

endif
```

## config/boards/shields/atreyu_rev2/Kconfig.shield
```kconfig
# Copyright (c) 2020 The ZMK Contributors
# SPDX-License-Identifier: MIT

config SHIELD_ATREYU_REV2
    def_bool $(shields_list_contains,atreyu)
```

## config/west.yml
```yaml
manifest:
  remotes:
    - name: zmkfirmware
      url-base: https://github.com/zmkfirmware
    - name: sofle
      url-base: https://github.com/zmkfirmware
  projects:
    - name: zmk
      remote: zmkfirmware
      revision: main
      import: app/west.yml
    - name: sofle
      remote: sofle
      revision: main
      url: https://github.com/zmkfirmware/zmk/tree/main/app/boards/shields/sofle
  self:
    path: config
```
